## conf/layer.conf
```bitbake
# We have a conf and classes directory, append to BBPATH
BBPATH .= ":${LAYERDIR}"

# We have a recipes directory, add to BBFILES
BBFILES += " \
	${LAYERDIR}/recipes*/*/*.bb \
	${LAYERDIR}/recipes*/*/*.bbappend \
	${LAYERDIR}/recipes*/*/*/*.bb \
	${LAYERDIR}/recipes*/*/*/*.bbappend \
"

BBFILE_COLLECTIONS += "meta-mesa"
BBFILE_PATTERN_meta-mesa := "^${LAYERDIR}/"
BBFILE_PRIORITY_meta-mesa = "10"

LAYERSERIES_COMPAT_meta-mesa = "sumo thud warrior zeus dunfell"

LAYERDEPENDS_meta-mesa = "core"
```
